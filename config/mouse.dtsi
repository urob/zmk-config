#define ZMK_POINTING_DEFAULT_MOVE_VAL 1500 // 600
#define ZMK_POINTING_DEFAULT_SCRL_VAL 50  // 10

#include <dt-bindings/zmk/pointing.h>
#include <input/processors.dtsi>

// Based on @caksoylar's config, defaults in comments
&mmv {
  acceleration-exponent = <1>;          // 1
  time-to-max-speed-ms = <500>;         // 300
  trigger-period-ms = <16>;
  // delay-ms = <0>;                       // 0
};

&msc {
  acceleration-exponent = <0>;          // 0
  time-to-max-speed-ms = <40>;         // 300
  trigger-period-ms = <16>;
  // delay-ms = <0>;                       // 0
};

&mmv_input_listener {
  precision {
    layers = <MOUSE_SLOW>;
    input-processors = <&zip_xy_scaler 1 4>;
  };
};


#define U_MS_U &mmv MOVE_UP
#define U_MS_D &mmv MOVE_DOWN
#define U_MS_L &mmv MOVE_LEFT
#define U_MS_R &mmv MOVE_RIGHT
#define U_WH_U &msc SCRL_UP
#define U_WH_D &msc SCRL_DOWN
#define U_WH_L &msc SCRL_LEFT
#define U_WH_R &msc SCRL_RIGHT
