/* source keypos definitions */
#include "../zmk-nodefree-config/keypos_def/keypos_36keys.h"

/* map Zen's extra keys */
#define XTR_MH  &kp BSPC  &kp RET  // thumb row, middle

/* activate bluetooth */
#define CONFIG_WIRELESS 1

/* source the main keymap */
#include "base.keymap"

/* use 5-column layout for Zen */
/ { chosen { zmk,matrix_transform = &five_column_transform; }; };

