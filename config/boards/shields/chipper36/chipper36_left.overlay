#include "chipper36.dtsi"

&kscan0 {
	col-gpios
		= <&gpio0 10 GPIO_ACTIVE_HIGH>   //Col0
		, <&gpio1 15 GPIO_ACTIVE_HIGH>   //Col1
		, <&gpio1 14 GPIO_ACTIVE_HIGH>   //Col2
		, <&gpio1 13 GPIO_ACTIVE_HIGH>   //Col3
		, <&gpio1 12 GPIO_ACTIVE_HIGH>   //Col4
		, <&gpio1 11 GPIO_ACTIVE_HIGH>   //Col5
		;
};