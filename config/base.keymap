#include <behaviors.dtsi>
#include <behaviors/num_word.dtsi> // Requires auto-layer module.
#include <dt-bindings/zmk/keys.h>
#ifdef CONFIG_WIRELESS
  #include <dt-bindings/zmk/bt.h>
  #include <dt-bindings/zmk/outputs.h>
#endif

#include "zmk-helpers/helper.h"
#include "zmk-helpers/unicode-chars/greek.dtsi"
#include "zmk-helpers/unicode-chars/german.dtsi"

#define DEF 0 /* Base layer */
#define DFA 1 /* Base + Alt layer */
#define DFE 2 /* Base + Esc layer */
#define NAV 3 /* Nav layer */
#define FN 4 /* Fn layer */
#define NUM 5 /* Num layer */
#define SYS 6 /* Sys layer */
#define MSL 7 /* Mouse left layer */
#define MSR 8 /* Mouse right layer */
#define MLA 9 /* Mouse left for Alt layer */
#define MRA 10 /* Mouse right for Alt layer */

#define XXX &none
#define ___ &trans

/* ======================= */
/* === Global defaults === */
/* ======================= */

#define QUICK_TAP_MS 175

// A sticky key stays pressed until another key is pressed.
// It is often used for 'sticky shift'. By using a sticky shift,
// you don't have to hold the shift key to write a capital.
&sk {
  release-after-ms = <900>; // release after 900 ms if not used.
  quick-release; // release immediately after it modifies a key
};

// A sticky layer stays pressed until another key is pressed.
// By using a sticky layer, you don't have to hold the layer key to access a layer.
// Instead, tap the sticky layer key to activate the layer until the next keypress.
&sl {
  ignore-modifiers; // allow sticky mods to chord across sticky layers.
};

// A hold-tap behavior is defined using a "hold" behavior and a "tap" behavior.
// When the key is held, then it will output the hold behavior,
// and when it is tapped it will output the tap behavior.
&lt {
  // "balanced" flavor will trigger the hold behavior when the tapping-term-ms has
  // expired or another key is pressed and released while the hold-tap is held.
  flavor = "balanced";

  // if you release the key within 200 ms, it is considered a tap.
  tapping-term-ms = <200>;

  // if a second tap happens within 175 ms, it is always treated as a tap (never a hold).
  quick-tap-ms = <QUICK_TAP_MS>;
};

/* ==================== */
/* === Homerow mods === */
/* ==================== */

#define KEYS_L LT0 LT1 LT2 LT3 LT4 LM0 LM1 LM2 LM3 LM4 LB0 LB1 LB2 LB3 LB4
#define KEYS_R RT0 RT1 RT2 RT3 RT4 RM0 RM1 RM2 RM3 RM4 RB0 RB1 RB2 RB3 RB4
#define THUMBS LH1 LH0 RH0 RH1

/* Macro to define a home-row mod (HRM) with consistent,
 * carefully tuned hold-tap behavior.
 *
 * NAME        - Name of the behavior
 * HOLD        - Binding when the key is held (usually a modifier)
 * TAP         - Binding when the key is tapped (usually a character)
 * TRIGGER_POS - Keys that are allowed to trigger the hold
 */
#define MAKE_HRM(NAME, HOLD, TAP, TRIGGER_POS)                                \
  ZMK_HOLD_TAP(NAME, bindings = <HOLD>, <TAP>;                                \
               /* Balanced decision strategy for HRMs */                      \
               flavor = "balanced";                                           \
                                                                              \
               /* This value defines how long a key must be pressed to        \
                * trigger the "hold" behavior.                                \
                */                                                            \
               tapping-term-ms = <200>;                                       \
               /* tapping-term-ms = <280>; */                                 \
                                                                              \
               /* If you press a tapped hold-tap again within quick-tap-ms    \
                * milliseconds of the first press, it will always trigger     \
                * the tap behavior. This is useful for keys like backspace,   \
                * where a quick tap-then-hold can be used to hold it down to  \
                * delete long parts of text.                                  \
                */                                                            \
               quick-tap-ms = <QUICK_TAP_MS>;                                 \
                                                                              \
               /* The key must have been idle for required ms before          \
                * it is allowed to become a hold. This prevents               \
                * accidental modifier activation during fast typing.          \
                */                                                            \
               /* require-prior-idle-ms = <150>; */                           \
               require-prior-idle-ms = <80>;                                  \
                                                                              \
               /* Decide tap vs hold on key release rather than               \
                * on key press, which makes rolls more forgiving.             \
                */                                                            \
               hold-trigger-on-release;                                       \
                                                                              \
               /* Pressing any key not listed in hold-trigger-key-positions   \
                * before tapping-term-ms expires, it will produce a tap.      \
                */                                                            \
               hold-trigger-key-positions = <TRIGGER_POS>;)

MAKE_HRM(hml, &kp, &kp, KEYS_R THUMBS) // Left-hand HRMs.
MAKE_HRM(hmr, &kp, &kp, KEYS_L THUMBS) // Right-hand HRMs.

// Hack: Make HRM combos tap-only (cf, ZMK issue #544).
#define ZMK_COMBO_8(NAME, TAP, POS, LAYERS, COMBO_MS, IDLE_MS, HOLD, SIDE)     \
  MAKE_HRM(hm_combo_##NAME, &kp, TAP, SIDE THUMBS)                             \
  ZMK_COMBO_6(NAME, &hm_combo_##NAME HOLD 0, POS, LAYERS, COMBO_MS, IDLE_MS)

/* =============================== */
/* === Combos, mouse emulation === */
/* =============================== */

#include "combos.dtsi" // Must be sourced after HRM-combo hack.
#include "mouse.dtsi"

/* =================== */
/* === Nav cluster === */
/* =================== */

// Trigger tap-action on all interrupts.
#define MT_CORE                                                                \
  flavor = "tap-preferred";                                                    \
  tapping-term-ms = <200>;                                                     \
  quick-tap-ms = <200>;                                                        \
  hold-trigger-key-positions = <0>;

//  tapping-term-ms = <220>;                                            \
//  quick-tap-ms = <220>;                                                        \

&mt { MT_CORE };

ZMK_HOLD_TAP(mt_home, bindings = <&masked_home>, <&kp>; MT_CORE)
ZMK_HOLD_TAP(mt_end, bindings = <&masked_end>, <&kp>; MT_CORE)

#define NAV_BSPC  &mt LC(BSPC) BSPC  // Tap: bspc  | Long-tap: delete word bwd.
#define NAV_DEL   &mt LC(DEL)  DEL   // Tap: del   | Long-tap: delete word fwd.

// Mask CTRL on left/right hold to avoid accidental jumps to start/end of doc.
#define MASK_MODS(NAME, MODS, BINDING)                                         \
  ZMK_MOD_MORPH(NAME, bindings = <BINDING>, <BINDING>; mods = <MODS>;)

MASK_MODS(masked_home, (MOD_LCTL), &kp HOME)
MASK_MODS(masked_end,  (MOD_LCTL), &kp END)

/* ================================= */
/* === Magic-shift & auto-layers === */
/* ================================= */

// Tap: repeat after alpha, else sticky-shift |
// Shift + tap/ double-tap: caps-word | Hold: shift.
#define MAGIC_SHIFT &magic_shift LSHFT 0
ZMK_HOLD_TAP(magic_shift, bindings = <&kp>, <&magic_shift_tap>;
               flavor = "balanced"; tapping-term-ms = <200>;
               quick-tap-ms = <QUICK_TAP_MS>;)
ZMK_MOD_MORPH(magic_shift_tap, bindings = <&caps_word>, <&shift_repeat>;
              mods = <(MOD_LSFT)>;)
ZMK_ADAPTIVE_KEY(
    shift_repeat, bindings = <&sk LSHFT>;
    repeat {
      trigger-keys = <A B C D E F G H I J K L M N O P Q R S T U V W X Y Z>;
      bindings = <&key_repeat>;
      max-prior-idle-ms = <1200>;
      strict-modifiers;
    };)
&caps_word { // Mods deactivate caps-word, requires PR #1451. [TODO: rebase]
  /delete-property/ ignore-modifiers;
};

// Tap: num-word | double-tap: sticky num-layer | Hold: num-layer.
#define SMART_NUM &smart_num NUM 0
ZMK_HOLD_TAP(smart_num, bindings = <&mo>, <&num_dance>; flavor = "balanced";
             tapping-term-ms = <200>; quick-tap-ms = <QUICK_TAP_MS>;)
ZMK_TAP_DANCE(num_dance, bindings = <&num_word NUM>, <&sl NUM>;
              tapping-term-ms = <200>;)

// Smart-mouse for left layer, requires tri-state module.
ZMK_TRI_STATE(
    smart_mouse_left, bindings = <&tog MSL>, <&none>, <&tog MSL>;
    ignored-key-positions =
      <LT4 LT3 LT2 LT1 LM4 LM3 LM2 LM1 LM0 LB3 LB2 LB1 LH1 LH0>;
    ignored-layers = <MSL NAV FN>;)

// Smart-mouse for left layer, requires tri-state module.
ZMK_TRI_STATE(
    smart_mouse_right, bindings = <&tog MSR>, <&none>, <&tog MSR>;
    ignored-key-positions =
      <RT4 RT2 RT1 RM4 RM3 RM2 RM1 RM0 LB3 LB2 LB1 RH1 RH0>;
    ignored-layers = <MSR NAV FN>;)

/* ======================== */
/* === Custom behaviors === */
/* ======================== */

// Alt+Tab swapper, requires tri-state module.
ZMK_TRI_STATE(swapper, bindings = <&kt LALT>, <&kp TAB>, <&kt LALT>;
              ignored-key-positions = <LT2 RT2 RM1 RM2 RM3>;)

// Define mod-morph with a *single* mod trigger for less repetition.
#define SIMPLE_MORPH(NAME, MOD, BINDING1, BINDING2)                            \
  ZMK_MOD_MORPH(NAME, mods = <(MOD_L##MOD | MOD_R##MOD)>;                      \
                bindings = <BINDING1>, <BINDING2>;)

// Tap: comma | Shift + tap: semicolon | Ctrl + shift + tap: <.

// used to force comma to be used when gui is pressed
// SIMPLE_MORPH(comma_gui_morph, GUI, &comma_morph, &kp COMMA)

// Set up to strip other modifiers when GUI is pressed to avoid : being fired
ZMK_MOD_MORPH(comma_gui_morph,
  /* trigger whenever LGUI or RGUI is down */
  mods      = <(MOD_LGUI | MOD_RGUI)>;
  /* strip *all* but GUI when firing */
  keep-mods = <(MOD_LGUI | MOD_RGUI)>;
  /* fall-through → your comma_morph, hold-side → send `,` */
  bindings  = <&comma_morph>, <&kp COMMA>;
  /* bindings  = <&comma_morph>, <&kp DOT>; */
)

// Tap: , | Shift + tap: ; | CTL + Shift + tap: <
SIMPLE_MORPH(comma_morph, SFT, &kp COMMA, &comma_inner_morph)
SIMPLE_MORPH(comma_inner_morph, CTL, &kp SEMICOLON, &kp LESS_THAN)

// Tap: dot | Shift + tap: colon | Ctrl + shift + tap: >.
/* SIMPLE_MORPH(dot_gui_morph, GUI, &dot_morph, &kp DOT) */

ZMK_MOD_MORPH(dot_gui_morph,
  /* trigger whenever LGUI or RGUI is down */
  mods      = <(MOD_LGUI | MOD_RGUI)>;
  /* strip *all* but GUI when firing */
  keep-mods = <(MOD_LGUI | MOD_RGUI)>;
  /* fall-through -> your dot_morph, hold-side -> send `.` */
  bindings  = <&dot_morph>, <&kp DOT>;
)

// Tap: . | Shift + tap: : | CTL + Shift + tap: >
SIMPLE_MORPH(dot_morph, SFT, &kp DOT, &dot_inner_morph)
SIMPLE_MORPH(dot_inner_morph, CTL, &kp COLON, &kp GREATER_THAN)

// Tap: qmark | Shift + tap: excl.
SIMPLE_MORPH(qexcl, SFT, &kp QMARK, &kp EXCL)

// Tap: forward slash | Shift + tap: back slash
SIMPLE_MORPH(qslash, SFT, &kp FSLH, &kp BSLH)

// Tap: left parenthesis ( | Shft + tap: less-than <
SIMPLE_MORPH(lpar_lt, SFT, &kp LPAR, &kp LT)

// Tap: right parenthesis ) | Shft + tap: greater-than >
SIMPLE_MORPH(rpar_gt, SFT, &kp RPAR, &kp GT)

// Macro that types `=>`
ZMK_BEHAVIOR(eqgt, macro, bindings = <&kp EQUAL &kp GREATER_THAN>;)

// Macro that types `->`
ZMK_BEHAVIOR(mngt, macro, bindings = <&kp MINUS &kp GREATER_THAN>;)

// Macro that types `|>`
ZMK_BEHAVIOR(pigt, macro, bindings = <&kp PIPE &kp GREATER_THAN>;)

// Macro to switch to bluetooth device 1 and automatically switch to DEF layer
ZMK_MACRO(dev_pers, bindings = <&bt BT_SEL 1>, <&to DEF>; wait-ms = <0>;
          tap-ms = <5>;)

// Macro to switch to bluetooth device 3 and automatically switch to DFE layer
ZMK_MACRO(dev_esc, bindings = <&bt BT_SEL 2>, <&to DFE>; wait-ms = <0>;
          tap-ms = <5>;)

// Macro to switch to bluetooth device 3 and automatically switch to DFA layer
ZMK_MACRO(dev_work, bindings = <&bt BT_SEL 3>, <&to DFA>; wait-ms = <0>;
          tap-ms = <5>;)

// TODO unused
// Tap: copy | double-tap: cut.
ZMK_TAP_DANCE(copy_cut, bindings = <&kp LC(INS)>, <&kp LC(X)>;
              tapping-term-ms = <200>;)

// Tap: F9 | double-tap: F11 | hold: alt
ZMK_TAP_DANCE(tp_f9_11, bindings = <&mt LALT F9>, <&kp F11>;
              tapping-term-ms = <200>;)

// Tap: F10 | double-tap: F12 | hold: gui
ZMK_TAP_DANCE(tp_f10_12, bindings = <&mt LALT F10>, <&kp F12>;
              tapping-term-ms = <200>;)

#define CANCEL    &kp K_CANCEL            // Cancel caps-word & auto-layers.


/* ============== */
/* === Keymap === */
/* ============== */

// ZMK_CONDITIONAL_LAYER(sys, FN NUM, SYS) // FN + NUM --> SYS.
ZMK_CONDITIONAL_LAYER(sys, FN NAV, SYS) // FN + NAV --> SYS.

#ifndef ZMK_BASE_LAYER
  #define ZMK_BASE_LAYER(name, LT, RT, LM, RM, LB, RB, LH, RH)                 \
      ZMK_LAYER(name, LT RT LM RM LB RB LH RH)
#endif

ZMK_BASE_LAYER(Base,
//╭─────────────┬─────────────┬─────────────┬─────────────┬─────────────╮ ╭─────────────┬─────────────┬─────────────┬─────────────┬─────────────╮
    &kp Q         &kp W         &kp E         &kp R         &kp T       ,   &kp Y         &kp U         &kp I         &kp O         &kp P,
//├─────────────┼─────────────┼─────────────┼─────────────┼─────────────┤ ├─────────────┼─────────────┼─────────────┼─────────────┼─────────────┤
    &hml LGUI A   &hml LALT S   &hml LSHFT D  &hml LCTRL F  &kp G       ,   &kp H         &hmr LCTRL J  &hmr RSHFT K  &hmr LALT L   &hmr LGUI SQT,
//├─────────────┼─────────────┼─────────────┼─────────────┼─────────────┤ ├─────────────┼─────────────┼─────────────┼─────────────┼─────────────┤
    &kp Z         &kp X         &kp C         &kp V         &kp B       ,   &kp N         &kp M         &comma_gui_morph  &dot_gui_morph &qexcl ,
//╰─────────────┼─────────────┴─────────────┼─────────────┼─────────────┤ ├─────────────┼─────────────┼─────────────┴───────────────────────────╯
                                              &hml LGUI CAPS &lt FN BSPC,  &lt NAV RET   &hml LGUI SPACE
//                                          ╰─────────────┴─────────────╯ ╰─────────────┴─────────────╯
)

ZMK_BASE_LAYER(Basealt,
//╭─────────────┬─────────────┬─────────────┬─────────────┬─────────────╮ ╭─────────────┬─────────────┬─────────────┬─────────────┬─────────────╮
    &kp Q         &kp W         &kp E         &kp R         &kp T       ,   &kp Y         &kp U         &kp I         &kp O         &kp P,
//├─────────────┼─────────────┼─────────────┼─────────────┼─────────────┤ ├─────────────┼─────────────┼─────────────┼─────────────┼─────────────┤
    &hml LGUI A   &hml LALT S   &hml LSHFT D  &hml LCTRL F  &kp G       ,   &kp H         &hmr LCTRL J  &hmr RSHFT K  &hmr LALT L   &hmr LGUI SQT,
//├─────────────┼─────────────┼─────────────┼─────────────┼─────────────┤ ├─────────────┼─────────────┼─────────────┼─────────────┼─────────────┤
    &kp Z         &kp X         &kp C         &kp V         &kp B       ,   &kp N         &kp M         &comma_gui_morph  &dot_gui_morph &qexcl ,
//╰─────────────┼─────────────┴─────────────┼─────────────┼─────────────┤ ├─────────────┼─────────────┼─────────────┴───────────────────────────╯
                                              &hml RALT CAPS &lt FN BSPC,  &lt NAV RET   &hml RALT SPACE
//                                          ╰─────────────┴─────────────╯ ╰─────────────┴─────────────╯
)

ZMK_BASE_LAYER(Baseesc,
//╭─────────────┬─────────────┬─────────────┬─────────────┬─────────────╮ ╭─────────────┬─────────────┬─────────────┬─────────────┬─────────────╮
    &kp Q         &kp W         &kp E         &kp R         &kp T       ,   &kp Y         &kp U         &kp I         &kp O         &kp P,
//├─────────────┼─────────────┼─────────────┼─────────────┼─────────────┤ ├─────────────┼─────────────┼─────────────┼─────────────┼─────────────┤
    &hml LGUI A   &hml LALT S   &hml LSHFT D  &hml LCTRL F  &kp G       ,   &kp H         &hmr LCTRL J  &hmr RSHFT K  &hmr LALT L   &hmr LGUI SQT,
//├─────────────┼─────────────┼─────────────┼─────────────┼─────────────┤ ├─────────────┼─────────────┼─────────────┼─────────────┼─────────────┤
    &kp Z         &kp X         &kp C         &kp V         &kp B       ,   &kp N         &kp M         &comma_gui_morph  &dot_gui_morph &qexcl ,
//╰─────────────┼─────────────┴─────────────┼─────────────┼─────────────┤ ├─────────────┼─────────────┼─────────────┴───────────────────────────╯
                                              &hml LGUI ESC &lt FN BSPC,  &lt NAV RET   &hml LGUI SPACE
//                                          ╰─────────────┴─────────────╯ ╰─────────────┴─────────────╯
)

// TODO set up transparent keys for layers

ZMK_BASE_LAYER(Nav,
//╭─────────────┬─────────────┬─────────────┬─────────────┬─────────────╮ ╭─────────────┬─────────────┬─────────────┬─────────────┬─────────────╮
    &kp N1        &kp N2        &kp N3        &kp N4        &kp N5      ,   &kp N6        &kp PG_UP     &kp PG_DN     &kp N9        &kp N0      ,
//├─────────────┼─────────────┼─────────────┼─────────────┼─────────────┤ ├─────────────┼─────────────┼─────────────┼─────────────┼─────────────┤
    ___           ___           ___           ___           ___         ,   &kp LEFT      &hmr LCTRL DOWN &hmr RSHFT UP &hmr LALT RIGHT ___     ,
//├─────────────┼─────────────┼─────────────┼─────────────┼─────────────┤ ├─────────────┼─────────────┼─────────────┼─────────────┼─────────────┤
    ___           ___           ___           ___           ___         ,   ___           &kp C_VOL_DN  &kp C_MUTE    &kp C_VOL_UP  ___         ,
//╰─────────────┼─────────────┴─────────────┼─────────────┼─────────────┤ ├─────────────┼─────────────┼─────────────┴───────────────────────────╯
                                              ___           &kp DEL     ,   ___           CANCEL
//                                          ╰─────────────┴─────────────╯ ╰─────────────┴─────────────╯
)

ZMK_BASE_LAYER(Fn,
//╭─────────────┬─────────────┬─────────────┬─────────────┬─────────────╮ ╭─────────────┬─────────────┬─────────────┬─────────────┬─────────────╮
    &kp N1        &kp N2        &kp N3        &kp N4        &kp N5      ,   &kp N6        &kp N7        &kp N8        &kp N9        &kp N0      ,
//├─────────────┼─────────────┼─────────────┼─────────────┼─────────────┤ ├─────────────┼─────────────┼─────────────┼─────────────┼─────────────┤
    &hml LGUI F1  &hml LALT F2  &hml LSHFT F3 &hml LCTRL F4 &hml LCTRL F5 , &kp F6        &hmr LCTRL F7 &hmr RSHFT F8 &tp_f9_11     &tp_f10_12  ,
//├─────────────┼─────────────┼─────────────┼─────────────┼─────────────┤ ├─────────────┼─────────────┼─────────────┼─────────────┼─────────────┤
    ___           &kp C_PREV    &kp C_PP      &kp C_NEXT    ___         ,   ___           &kp C_VOL_DN  &kp C_MUTE    &kp C_VOL_UP  ___         ,
//╰─────────────┼─────────────┴─────────────┼─────────────┼─────────────┤ ├─────────────┼─────────────┼─────────────┴───────────────────────────╯
                                              ___           ___         ,   ___           ___
//                                          ╰─────────────┴─────────────╯ ╰─────────────┴─────────────╯
)

ZMK_BASE_LAYER(Num,
//╭─────────────┬─────────────┬─────────────┬─────────────┬─────────────╮ ╭─────────────┬─────────────┬─────────────┬─────────────┬─────────────╮
    ___           &kp N7        &kp N8        &kp N9        ___         ,   ___           ___           ___           ___           ___         ,
//├─────────────┼─────────────┼─────────────┼─────────────┼─────────────┤ ├─────────────┼─────────────┼─────────────┼─────────────┼─────────────┤
    &hml LGUI N0  &hml LALT N4  &hml LSHFT N5 &hml LCTRL N6 ___         ,   ___           ___           ___           ___           ___         ,
//├─────────────┼─────────────┼─────────────┼─────────────┼─────────────┤ ├─────────────┼─────────────┼─────────────┼─────────────┼─────────────┤
    ___           &kp N1        &kp N2        &kp N3        ___         ,   ___           ___           ___           ___           ___         ,
//╰─────────────┼─────────────┴─────────────┼─────────────┼─────────────┤ ├─────────────┼─────────────┼─────────────┴───────────────────────────╯
                                              ___           ___         ,   ___           ___
//                                          ╰─────────────┴─────────────╯ ╰─────────────┴─────────────╯
)

ZMK_BASE_LAYER(Sys,
//╭─────────────┬─────────────┬─────────────┬─────────────┬─────────────╮ ╭─────────────┬─────────────┬─────────────┬─────────────┬─────────────╮
    &bt BT_SEL 0  &dev_pers     &dev_esc      &dev_work     &bt BT_CLR  ,   ___           ___           ___           ___           ___         ,
//├─────────────┼─────────────┼─────────────┼─────────────┼─────────────┤ ├─────────────┼─────────────┼─────────────┼─────────────┼─────────────┤
    ___           ___           ___           ___           &bootloader ,   &bootloader   ___           ___           ___           ___         ,
//├─────────────┼─────────────┼─────────────┼─────────────┼─────────────┤ ├─────────────┼─────────────┼─────────────┼─────────────┼─────────────┤
    ___           ___           ___           ___           &sys_reset  ,   &sys_reset    ___           ___           ___           ___         ,
//╰─────────────┼─────────────┴─────────────┼─────────────┼─────────────┤ ├─────────────┼─────────────┼─────────────┴───────────────────────────╯
                                              ___           ___         ,   ___           ___
//                                          ╰─────────────┴─────────────╯ ╰─────────────┴─────────────╯
)

ZMK_BASE_LAYER(Mousel,
//╭─────────────┬─────────────┬─────────────┬─────────────┬─────────────╮ ╭─────────────┬─────────────┬─────────────┬─────────────┬─────────────╮
    U_WH_U        &kp PG_UP     U_MS_U        &kp PG_DN     ___         ,   ___           ___           ___           ___           ___         ,
//├─────────────┼─────────────┼─────────────┼─────────────┼─────────────┤ ├─────────────┼─────────────┼─────────────┼─────────────┼─────────────┤
    U_WH_D        U_MS_L        U_MS_D        U_MS_R        U_MS_L      ,   ___           ___           ___           ___           ___         ,
//├─────────────┼─────────────┼─────────────┼─────────────┼─────────────┤ ├─────────────┼─────────────┼─────────────┼─────────────┼─────────────┤
    ___           &kp X         &kp C         &kp V         ___         ,   ___           ___           ___           ___           ___         ,
//╰─────────────┼─────────────┴─────────────┼─────────────┼─────────────┤ ├─────────────┼─────────────┼─────────────┴───────────────────────────╯
                                              &mkp RCLK     &mkp LCLK   ,   ___           ___
//                                          ╰─────────────┴─────────────╯ ╰─────────────┴─────────────╯
)

ZMK_BASE_LAYER(Mouser,
//╭─────────────┬─────────────┬─────────────┬─────────────┬─────────────╮ ╭─────────────┬─────────────┬─────────────┬─────────────┬─────────────╮
    ___           ___           ___           ___           ___         ,   ___           &kp PG_UP     &kp PG_DN     ___           U_WH_U      ,
//├─────────────┼─────────────┼─────────────┼─────────────┼─────────────┤ ├─────────────┼─────────────┼─────────────┼─────────────┼─────────────┤
    ___           ___           ___           ___           ___         ,   U_MS_L        U_MS_D        U_MS_U        U_MS_R        U_WH_D      ,
//├─────────────┼─────────────┼─────────────┼─────────────┼─────────────┤ ├─────────────┼─────────────┼─────────────┼─────────────┼─────────────┤
    ___           ___           ___           ___           ___         ,   ___           ___           ___           ___           ___         ,
//╰─────────────┼─────────────┴─────────────┼─────────────┼─────────────┤ ├─────────────┼─────────────┼─────────────┴───────────────────────────╯
                                              ___           ___         ,   &mkp LCLK     &mkp RCLK
//                                          ╰─────────────┴─────────────╯ ╰─────────────┴─────────────╯
)

ZMK_BASE_LAYER(Mouselalt,
//╭─────────────┬─────────────┬─────────────┬─────────────┬─────────────╮ ╭─────────────┬─────────────┬─────────────┬─────────────┬─────────────╮
    U_WH_U        &kp PG_UP     U_MS_U        &kp PG_DN     ___         ,   ___           ___           ___           ___           ___         ,
//├─────────────┼─────────────┼─────────────┼─────────────┼─────────────┤ ├─────────────┼─────────────┼─────────────┼─────────────┼─────────────┤
    U_WH_D        U_MS_L        U_MS_D        U_MS_R        U_MS_L      ,   ___           ___           ___           ___           ___         ,
//├─────────────┼─────────────┼─────────────┼─────────────┼─────────────┤ ├─────────────┼─────────────┼─────────────┼─────────────┼─────────────┤
    ___           &kp X         &kp C         &kp V         ___         ,   ___           ___           ___           ___           ___         ,
//╰─────────────┼─────────────┴─────────────┼─────────────┼─────────────┤ ├─────────────┼─────────────┼─────────────┴───────────────────────────╯
                                              &mkp RCLK     &mkp LCLK   ,   ___           ___
//                                          ╰─────────────┴─────────────╯ ╰─────────────┴─────────────╯
)

ZMK_BASE_LAYER(Mouseralt,
//╭─────────────┬─────────────┬─────────────┬─────────────┬─────────────╮ ╭─────────────┬─────────────┬─────────────┬─────────────┬─────────────╮
    ___           ___           ___           ___           ___         ,   ___           &kp PG_UP     &kp PG_DN     ___           U_WH_U      ,
//├─────────────┼─────────────┼─────────────┼─────────────┼─────────────┤ ├─────────────┼─────────────┼─────────────┼─────────────┼─────────────┤
    ___           ___           ___           ___           ___         ,   U_MS_L        U_MS_D        U_MS_U        U_MS_R        U_WH_D      ,
//├─────────────┼─────────────┼─────────────┼─────────────┼─────────────┤ ├─────────────┼─────────────┼─────────────┼─────────────┼─────────────┤
    ___           ___           ___           ___           ___         ,   ___           ___           ___           ___           ___         ,
//╰─────────────┼─────────────┴─────────────┼─────────────┼─────────────┤ ├─────────────┼─────────────┼─────────────┴───────────────────────────╯
                                              ___           ___         ,   &mkp LCLK     &mkp RCLK
//                                          ╰─────────────┴─────────────╯ ╰─────────────┴─────────────╯
)

/* vim: set ft=c tw=146: */
