// Personal changes live in this file, corne.conf and custom/. urob's files
// (base.keymap, combos.dtsi, ...) stay untouched so upstream merges are clean.

#define CONFIG_WIRELESS
#define ZMK_BASE_LAYER(name, LT, RT, LM, RM, LB, RB, LH, RH)                   \
    ZMK_LAYER(                                                                 \
        name,                                                                  \
        ___      LT RT ___                                                     \
        ___      LM RM ___                                                     \
        ___      LB RB ___                                                     \
        &kp LGUI LH RH &smart_mouse                                            \
    )

#include "zmk-helpers/key-labels/42.h"
#include "base.keymap"

#include "custom/behaviors.dtsi"
#include "custom/layers.dtsi"
