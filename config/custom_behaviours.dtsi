
/* configuration */

#undef COMBO_TERM
#define COMBO_TERM 25

#undef COMBO_HOOK
#define COMBO_HOOK require-prior-idle-ms = <25>;

#undef CONFIG_ZMK_MACRO_DEFAULT_WAIT_MS
#define CONFIG_ZMK_MACRO_DEFAULT_WAIT_MS 5;

#undef CONFIG_ZMK_MACRO_DEFAULT_TAP_MS
#define CONFIG_ZMK_MACRO_DEFAULT_TAP_MS 5;

/* locals */

#define QUICK_TAP_MS 160
#define QUICK_TAP_SHORT 120
#define TAPPING_TERM_MS 190
#define TAPPING_TERM_SHORT 160
#define PRIOR_IDLE_MS 150
#define PRIOR_IDLE_SHORT 120

/* configure behaviour defaults */

&sk {
  release-after-ms = <900>;
  quick-release;
};

&sl { // Allow sticky mods to chord across sticky layers.
  ignore-modifiers;
};

&lt {
  flavor = "balanced";
  tapping-term-ms = <TAPPING_TERM_MS>;
  quick-tap-ms = <QUICK_TAP_MS>;
};

&mt {
  // flavor = "tap-preferred";
  flavor = "balanced";
  tapping-term-ms = <TAPPING_TERM_MS>;
  quick-tap-ms = <QUICK_TAP_MS>;
  // hold-trigger-key-positions = <0>;
};

/ { // TODO: unused
    new_sentence: new_sentence {
      compatible = "zmk,behavior-macro";
      #binding-cells = <0>;
      wait-ms = <5>;
      tap-ms = <5>;
      bindings = <&macro_tap &kp DOT &kp SPACE>, <&sk LSHFT>;
    };
};

/*
* Home Row Mods
* */

#define MAKE_HRM(NAME, HOLD, TAP, TRIGGER_POS) \
  ZMK_HOLD_TAP(NAME, bindings = <HOLD>, <TAP>; \
    flavor = "balanced";                       \
    tapping-term-ms = <TAPPING_TERM_MS>;       \
    quick-tap-ms = <QUICK_TAP_SHORT>;          \
    require-prior-idle-ms = <PRIOR_IDLE_MS>;   \
    hold-trigger-on-release;                   \
    hold-trigger-key-positions = <TRIGGER_POS>;)

MAKE_HRM(hml, &kp, &kp, KEYS_R THUMBS) // Left-hand HRMs.
MAKE_HRM(hmr, &kp, &kp, KEYS_L THUMBS) // Right-hand HRMs.

// Hack: Make HRM combos tap-only (cf, ZMK issue #544).
#define ZMK_COMBO_8(NAME, TAP, POS, LAYERS, COMBO_MS, IDLE_MS, HOLD, SIDE)     \
  MAKE_HRM(hm_combo_##NAME, &kp, TAP, SIDE THUMBS)                             \
  ZMK_COMBO_6(NAME, &hm_combo_##NAME HOLD 0, POS, LAYERS, COMBO_MS, IDLE_MS)

/* thumb shift | backspace */
ZMK_BEHAVIOR(th, hold_tap,
    flavor = "balanced";
    tapping-term-ms = <TAPPING_TERM_SHORT>;
    bindings = <&kp>, <&kp>;
    quick-tap-ms = <QUICK_TAP_MS>; // tap-then-tap-and-hold for space / backspace
)

/* auto-shift */
#define AS(keycode) &as LS(keycode) keycode
ZMK_BEHAVIOR(as, hold_tap,
    flavor = "tap-preferred";
    tapping-term-ms = <TAPPING_TERM_MS>;
    bindings = <&kp>, <&kp>;
    quick-tap-ms = <QUICK_TAP_MS>;
    require-prior-idle-ms = <PRIOR_IDLE_MS>;
)

ZMK_BEHAVIOR(mo_sk, hold_tap,
    flavor = "balanced";
    tapping-term-ms = <TAPPING_TERM_SHORT>;
    bindings = <&mo>, <&sk>;
    quick-tap-ms = <QUICK_TAP_SHORT>; // tap-then-tap-and-hold for space / backspace
)

&caps_word { // Mods deactivate caps-word, requires PR #1451. [TODO: rebase]
  /delete-property/ ignore-modifiers;
};

/*
* https://github.com/urob/zmk-auto-layer/tree/main
&num_word {
  continue-list = <BSPC DEL DOT COMMA>;
};
*/

//
// Tap Dance keys
//

// DEF layer
ZMK_BEHAVIOR(fn_esc__cmd, tap_dance,
  tapping-term-ms = <180>;
  bindings = <&lt FN ESC>, <&kp LCMD>;
)

// GAM layer

// tap: spare
// tap-hold: Alt
// tap tap-hold: NUM layer
ZMK_BEHAVIOR(alt__num, tap_dance,
  tapping-term-ms = <180>;
  bindings = <&kp LALT>, <&mo NUM>;
)

// tap: F5
// tap tap: sticky NUM
ZMK_BEHAVIOR(f5__num_sl, tap_dance,
  tapping-term-ms = <180>;
  bindings = <&kp F5>, <&sl NUM>;
)

// one tap: num-word
// two taps: exit to DEF
ZMK_BEHAVIOR(td_rth3, tap_dance,
  tapping-term-ms = <180>;
  bindings = <&num_word NUM>, <&to DEF>;
)


/* zmk-new_corne converted behaviors

ZMK_BEHAVIOR(tap_flip_komorebic,
     tap_dance,
        tapping-term-ms = <250>;
        bindings = <&kp RS(RA(F17))>,
     <&kp RA(RS(F18))>, <&none>;
    )

        num_word: num_word {
            compatible = "zmk,behavior-auto-layer";
            #binding-cells = <1>;
            continue-list = <BSPC DEL KP_DOT DOT COMMA KP_PLUS PLUS KP_MINUS MINUS KP_MULTIPLY STAR KP_DIVIDE FSLH EQUAL>;
            ignore-numbers;
        };

        smart_num: smart_num {
            compatible = "zmk,behavior-hold-tap";
            label = "SMART_NUM";
            bindings = <&mo>, <&num_word>;

            #binding-cells = <2>;
            tapping-term-ms = <175>;
            flavor = "balanced";
            hold-trigger-key-positions = <41>;
            quick-tap-ms = <150>;
            hold-while-undecided;
        };

	   backspace_delete: backspace_delete {
            compatible = "zmk,behavior-mod-morph";
            #binding-cells = <0>;
            bindings = <&kp BACKSPACE>, <&kp DELETE>;

            mods = <(MOD_LSFT|MOD_RSFT)>;
            keep-mods = <(MOD_RSFT)>;
            label = "BACKSPACE_DELETE";
        };

        tap_dot_shift: tap_dot_shift {
            compatible = "zmk,behavior-tap-dance";
            label = "tap_dot_shift";
            #binding-cells = <0>;
            bindings = <&kp DOT>, <&macro_dot_shift>;

            tapping-term-ms = <250>;
        };

        mo_dot_shift: mo_dot_shift {
            compatible = "zmk,behavior-hold-tap";
            label = "MO_DOT_SHIFT";
            bindings = <&macro_dot_shift>, <&kp>;

            #binding-cells = <2>;
            tapping-term-ms = <250>;
            quick-tap-ms = <200>;
            flavor = "tap-preferred";
            require-prior-idle-ms = <150>;
            hold-trigger-on-release;
        };

        hmr_clk: hmr_clk {
            compatible = "zmk,behavior-hold-tap";
            label = "HMR_CLK";
            bindings = <&hmr>, <&mkp>;

            #binding-cells = <2>;
            tapping-term-ms = <250>;
            quick-tap-ms = <200>;
            flavor = "tap-preferred";
            require-prior-idle-ms = <150>;
        };

        tap_paste: tap_paste {
            compatible = "zmk,behavior-tap-dance";
            label = "TAP_PASTE";
            #binding-cells = <0>;
            tapping-term-ms = <250>;
            bindings = <&kp LC(V)>, <&kp LC(LS(V))>;
        };

        tap_copy_cut: tap_copy_cut {
            compatible = "zmk,behavior-tap-dance";
            label = "TAP_COPY_CUT";
            #binding-cells = <0>;
            tapping-term-ms = <250>;
            bindings = <&kp LC(C)>, <&kp LC(X)>;
        };

        tap_dot_shift_capsword: tap_dot_shift_capsword {
            compatible = "zmk,behavior-tap-dance";
            label = "TAP_DOT_SHIFT_CAPSWORD";
            #binding-cells = <0>;
            tapping-term-ms = <250>;
            bindings = <&as_dot_shift 0 DOT>, <&macro_dot_shift>, <&caps_word>;
        };

        tap_key_repeat_lt: tap_key_repeat_lt {
            compatible = "zmk,behavior-hold-tap";
            label = "TAP_KEY_REPEAT_LT";
            #binding-cells = <2>;
            tapping-term-ms = <225>;
            quick-tap-ms = <175>;
            flavor = "balanced";
            require-prior-idle-ms = <50>;
            bindings = <&mo>, <&key_repeat>;
        };

        kp_to: kp_to {
            compatible = "zmk,behavior-hold-tap";
            label = "KP_TO";
            bindings = <&to>, <&kp>;

            #binding-cells = <2>;
            tapping-term-ms = <175>;
            quick-tap-ms = <175>;
            flavor = "balanced";
            require-prior-idle-ms = <50>;
        };

        mod_to0_mouse_jiggle: mod_to0_mouse_jiggle {
            compatible = "zmk,behavior-hold-tap";
            label = "MOD_TO0_MOUSE_JIGGLE";
            bindings = <&macro_mouse_jiggle>, <&kp>;

            #binding-cells = <2>;
            tapping-term-ms = <225>;
            quick-tap-ms = <175>;
            flavor = "tap-preferred";
            require-prior-idle-ms = <50>;
        };

        tap_key_repeat_to: tap_key_repeat_to {
            compatible = "zmk,behavior-hold-tap";
            label = "TAP_KEY_REPEAT_TO";
            bindings = <&to>, <&key_repeat>;

            #binding-cells = <2>;
            tapping-term-ms = <225>;
            quick-tap-ms = <175>;
            flavor = "balanced";
            require-prior-idle-ms = <50>;
        };

        macro_dot_shift_lt: macro_dot_shift_lt {
            compatible = "zmk,behavior-hold-tap";
            label = "MACRO_DOT_SHIFT_LT";
            #binding-cells = <2>;
            tapping-term-ms = <225>;
            quick-tap-ms = <175>;
            flavor = "balanced";
            require-prior-idle-ms = <50>;
            bindings = <&lt>, <&macro_dot_shift>;
        };

        shift_mod: shift_mod {
            compatible = "zmk,behavior-hold-tap";
            label = "SHIFT_MOD";
            bindings = <&kp>, <&kp>;

            #binding-cells = <2>;
            tapping-term-ms = <125>;
            quick-tap-ms = <150>;
            flavor = "balanced";
            require-prior-idle-ms = <0>;
            hold-trigger-key-positions = <14 15 16 17 0 1 13 26 27 28 29 31 5 2 3 4 18 23 45 46 44 30 33 20 7 8 21 34 22 9 35 36 37 38 25 24 11 12 10 41 42 40 39 19 32 47 43 6>;
        };

        as_dot_shift: as_dot_shift {
            compatible = "zmk,behavior-hold-tap";
            label = "AS_DOT_SHIFT";
            bindings = <&mo_dot_shift>, <&kp>;

            #binding-cells = <2>;
            tapping-term-ms = <175>;
            flavor = "balanced";
        };

        tap_key_repeat_sk_shift: tap_key_repeat_sk_shift {
            compatible = "zmk,behavior-hold-tap";
            label = "TAP_KEY_REPEAT_SK_SHIFT";
            #binding-cells = <2>;
            tapping-term-ms = <150>;
            quick-tap-ms = <150>;
            flavor = "balanced";
            require-prior-idle-ms = <50>;
            bindings = <&sk>, <&key_repeat>;

            hold-trigger-key-positions = <0 1 14 27 2 3 4 5 15 16 17 18 28 29 30 31 6 19 43 47 32 7 8 9 10 11 12 20 21 22 23 24 25 33 34 35 36 37 38>;
        };

        sk_shift_dot_shift: sk_shift_dot_shift {
            compatible = "zmk,behavior-hold-tap";
            label = "SK_SHIFT_DOT_SHIFT";
            bindings = <&macro_dot_shift>, <&sk>;

            #binding-cells = <2>;
            tapping-term-ms = <250>;
            flavor = "tap-preferred";
            quick-tap-ms = <200>;
        };

        mo_num_word: mo_num_word {
            compatible = "zmk,behavior-hold-tap";
            label = "MO_NUM_WORD";
            bindings = <&num_word>, <&kp>;

            #binding-cells = <2>;
            tapping-term-ms = <175>;
            flavor = "tap-preferred";
            quick-tap-ms = <150>;
        };

        mouse_word: mouse_word {
            compatible = "zmk,behavior-auto-layer";
            #binding-cells = <1>;
            continue-list = <PG_DN PG_UP SCRL_LEFT SCRL_RIGHT SCRL_DOWN SCRL_UP LCLK RCLK MCLK MOVE_LEFT MOVE_RIGHT MOVE_UP MOVE_DOWN>;
            ignore-numbers;
            label = "MOUSE_WORD";
        };

        nav_word: nav_word {
            compatible = "zmk,behavior-auto-layer";
            #binding-cells = <1>;
            continue-list = <SCRL_LEFT SCRL_RIGHT SCRL_DOWN SCRL_UP LCLK RCLK MCLK MOVE_LEFT MOVE_RIGHT MOVE_UP MOVE_DOWN LEFT DOWN UP RIGHT PG_DN PG_UP HOME END ENTER BACKSPACE DEL>;
            ignore-numbers;
            label = "NAV_WORD";
        };

        wm_word: wm_word {
            compatible = "zmk,behavior-auto-layer";
            #binding-cells = <1>;
            continue-list = <F13 F14 F15 F22 F17 F18 F19 F20 F21 F22>;
            ignore-numbers;
            label = "WM_WORD";
        };

        tap_key_repeat_wm_word: tap_key_repeat_wm_word {
            compatible = "zmk,behavior-hold-tap";
            label = "TAP_KEY_REPEAT_WM_WORD";
            bindings = <&wm_word>, <&key_repeat>;

            #binding-cells = <2>;
            tapping-term-ms = <175>;
            quick-tap-ms = <150>;
            require-prior-idle-ms = <150>;
            flavor = "tap-preferred";
        };

        mo_nav_word: mo_nav_word {
            compatible = "zmk,behavior-hold-tap";
            label = "MO_NAV_WORD";
            bindings = <&nav_word>, <&kp>;

            #binding-cells = <2>;
            flavor = "balanced";
            tapping-term-ms = <175>;
            quick-tap-ms = <150>;
        };

        lt_num_word: lt_num_word {
            compatible = "zmk,behavior-hold-tap";
            label = "LT_NUM_WORD";
            bindings = <&mo>, <&num_word>;

            #binding-cells = <2>;
            tapping-term-ms = <175>;
            flavor = "tap-preferred";
            quick-tap-ms = <150>;
        };

        lt_nav_word: lt_nav_word {
            compatible = "zmk,behavior-hold-tap";
            label = "LT_NAV_WORD";
            bindings = <&mo>, <&nav_word>;

            #binding-cells = <2>;
            tapping-term-ms = <175>;
            flavor = "tap-preferred";
            quick-tap-ms = <150>;
        };

        kp_msc: kp_msc {
            compatible = "zmk,behavior-hold-tap";
            label = "KP_MSC";
            bindings = <&msc>, <&kp>;

            #binding-cells = <2>;
            tapping-term-ms = <175>;
            flavor = "balanced";
            quick-tap-ms = <150>;
            hold-trigger-key-positions = <21 22 23 24 45>;
            require-prior-idle-ms = <150>;
        };

        tap_repeat_mouse_word: tap_repeat_mouse_word {
            compatible = "zmk,behavior-hold-tap";
            label = "TAP_REPEAT_MOUSE_WORD";
            bindings = <&mouse_word>, <&key_repeat>;

            #binding-cells = <2>;
            tapping-term-ms = <175>;
            quick-tap-ms = <150>;
            require-prior-idle-ms = <150>;
            flavor = "tap-preferred";
        };

        tap_sk_shift_dot_caps_word_lt: tap_sk_shift_dot_caps_word_lt {
            compatible = "zmk,behavior-tap-dance";
            label = "TAP_SK_SHIFT_DOT_CAPS_WORD_LT";
            #binding-cells = <0>;
            bindings = <&sk LSHIFT>, <&macro_dot_shift>, <&caps_word>;

            tapping-term-ms = <350>;
        };

        smart_sk_lt: smart_sk_lt {
            compatible = "zmk,behavior-hold-tap";
            label = "SMART_SK_LT";
            bindings = <&lt>, <&tap_sk_shift_dot_caps_word_lt>;

            #binding-cells = <2>;
            tapping-term-ms = <500>;
            quick-tap-ms = <450>;
            flavor = "balanced";
            hold-trigger-key-positions = <0 1 2 3 4 5 7 8 9 10 11 12 13 14 15 16 17 18 19 20 21 22 23 24 25 26 27 28 29 30 31 32 33 34 35 36 37 38 39 40 41 42 43 44 45 46 47 6>;
        };


*/

// Auto Layer
ZMK_BEHAVIOR(num_word, auto_layer,
    continue-list = <BSPC DEL KP_DOT DOT COMMA KP_PLUS PLUS KP_MINUS MINUS KP_MULTIPLY STAR KP_DIVIDE FSLH EQUAL>;
    ignore-numbers;
)
ZMK_BEHAVIOR(mouse_word, auto_layer,
    continue-list = <PG_DN PG_UP SCRL_LEFT SCRL_RIGHT SCRL_DOWN SCRL_UP LCLK RCLK MCLK MOVE_LEFT MOVE_RIGHT MOVE_UP MOVE_DOWN>;
    ignore-numbers;
)
ZMK_BEHAVIOR(nav_word, auto_layer,
    continue-list = <SCRL_LEFT SCRL_RIGHT SCRL_DOWN SCRL_UP LCLK RCLK MCLK MOVE_LEFT MOVE_RIGHT MOVE_UP MOVE_DOWN LEFT DOWN UP RIGHT PG_DN PG_UP HOME END ENTER BACKSPACE DEL>;
    ignore-numbers;
)
ZMK_BEHAVIOR(wm_word, auto_layer,
    continue-list = <F13 F14 F15 F22 F17 F18 F19 F20 F21 F22>;
    ignore-numbers;
)

// Mod Morph
ZMK_BEHAVIOR(backspace_delete, mod_morph,
    bindings = <&kp BACKSPACE>, <&kp DELETE>;
    mods = <(MOD_LSFT|MOD_RSFT)>;
    keep-mods = <(MOD_RSFT)>;
)

// Tap Dance
/* ZMK_BEHAVIOR(tap_dot_shift, tap_dance, */
/*     tapping-term-ms = <250>; */
/*     bindings = <&kp DOT>, <&macro_dot_shift>; */
/* ) */
ZMK_BEHAVIOR(tap_paste, tap_dance,
    tapping-term-ms = <250>;
    bindings = <&kp LC(V)>, <&kp LC(LS(V))>;
)
ZMK_BEHAVIOR(tap_copy_cut, tap_dance,
    tapping-term-ms = <250>;
    bindings = <&kp LC(C)>, <&kp LC(X)>;
/* ) */
/* ZMK_BEHAVIOR(tap_dot_shift_capsword, tap_dance, */
/*     tapping-term-ms = <250>; */
/*     bindings = <&as_dot_shift 0 DOT>, <&macro_dot_shift>, <&caps_word>; */
/* ) */
/* ZMK_BEHAVIOR(tap_sk_shift_dot_caps_word_lt, tap_dance, */
/*     tapping-term-ms = <350>; */
/*     bindings = <&sk LSHIFT>, <&macro_dot_shift>, <&caps_word>; */
/* ) */

// Hold-Taps
ZMK_BEHAVIOR(smart_num, hold_tap,
    bindings = <&mo>, <&num_word>;
    tapping-term-ms = <175>;
    flavor = "balanced";
    hold-trigger-key-positions = <41>;
    quick-tap-ms = <150>;
    hold-while-undecided;
)
/* ZMK_BEHAVIOR(mo_dot_shift, hold_tap, */
/*     bindings = <&macro_dot_shift>, <&kp>; */
/*     tapping-term-ms = <250>; */
/*     quick-tap-ms = <200>; */
/*     flavor = "tap-preferred"; */
/*     require-prior-idle-ms = <150>; */
/*     hold-trigger-on-release; */
/* ) */
ZMK_BEHAVIOR(hmr_clk, hold_tap,
    bindings = <&hmr>, <&mkp>;
    tapping-term-ms = <250>;
    quick-tap-ms = <200>;
    flavor = "tap-preferred";
    require-prior-idle-ms = <150>;
)
ZMK_BEHAVIOR(tap_key_repeat_lt, hold_tap,
    bindings = <&mo>, <&key_repeat>;
    tapping-term-ms = <225>;
    quick-tap-ms = <175>;
    flavor = "balanced";
    require-prior-idle-ms = <50>;
)
ZMK_BEHAVIOR(kp_to, hold_tap,
    bindings = <&to>, <&kp>;
    tapping-term-ms = <175>;
    quick-tap-ms = <175>;
    flavor = "balanced";
    require-prior-idle-ms = <50>;
)
ZMK_BEHAVIOR(mod_to0_mouse_jiggle, hold_tap,
    bindings = <&macro_mouse_jiggle>, <&kp>;
    tapping-term-ms = <225>;
    quick-tap-ms = <175>;
    flavor = "tap-preferred";
    require-prior-idle-ms = <50>;
)
ZMK_BEHAVIOR(tap_key_repeat_to, hold_tap,
    bindings = <&to>, <&key_repeat>;
    tapping-term-ms = <225>;
    quick-tap-ms = <175>;
    flavor = "balanced";
    require-prior-idle-ms = <50>;
)
/* ZMK_BEHAVIOR(macro_dot_shift_lt, hold_tap, */
/*     bindings = <&lt>, <&macro_dot_shift>; */
/*     tapping-term-ms = <225>; */
/*     quick-tap-ms = <175>; */
/*     flavor = "balanced"; */
/*     require-prior-idle-ms = <50>; */
/* ) */
ZMK_BEHAVIOR(shift_mod, hold_tap,
    bindings = <&kp>, <&kp>;
    tapping-term-ms = <125>;
    quick-tap-ms = <150>;
    flavor = "balanced";
    require-prior-idle-ms = <0>;
    hold-trigger-key-positions = <14 15 16 17 0 1 13 26 27 28 29 31 5 2 3 4 18 23 45 46 44 30 33 20 7 8 21 34 22 9 35 36 37 38 25 24 11 12 10 41 42 40 39 19 32 47 43 6>;
)
ZMK_BEHAVIOR(as_dot_shift, hold_tap,
    bindings = <&mo_dot_shift>, <&kp>;
    tapping-term-ms = <175>;
    flavor = "balanced";
)
ZMK_BEHAVIOR(tap_key_repeat_sk_shift, hold_tap,
    bindings = <&sk>, <&key_repeat>;
    tapping-term-ms = <150>;
    quick-tap-ms = <150>;
    flavor = "balanced";
    require-prior-idle-ms = <50>;
    hold-trigger-key-positions = <0 1 14 27 2 3 4 5 15 16 17 18 28 29 30 31 6 19 43 47 32 7 8 9 10 11 12 20 21 22 23 24 25 33 34 35 36 37 38>;
)
/* ZMK_BEHAVIOR(sk_shift_dot_shift, hold_tap, */
/*     bindings = <&macro_dot_shift>, <&sk>; */
/*     tapping-term-ms = <250>; */
/*     flavor = "tap-preferred"; */
/*     quick-tap-ms = <200>; */
/* ) */
ZMK_BEHAVIOR(mo_num_word, hold_tap,
    bindings = <&num_word>, <&kp>;
    tapping-term-ms = <175>;
    flavor = "tap-preferred";
    quick-tap-ms = <150>;
)
ZMK_BEHAVIOR(tap_key_repeat_wm_word, hold_tap,
    bindings = <&wm_word>, <&key_repeat>;
    tapping-term-ms = <175>;
    quick-tap-ms = <150>;
    require-prior-idle-ms = <150>;
    flavor = "tap-preferred";
)
ZMK_BEHAVIOR(mo_nav_word, hold_tap,
    bindings = <&nav_word>, <&kp>;
    flavor = "balanced";
    tapping-term-ms = <175>;
    quick-tap-ms = <150>;
)
ZMK_BEHAVIOR(lt_num_word, hold_tap,
    bindings = <&mo>, <&num_word>;
    tapping-term-ms = <175>;
    flavor = "tap-preferred";
    quick-tap-ms = <150>;
)
ZMK_BEHAVIOR(lt_nav_word, hold_tap,
    bindings = <&mo>, <&nav_word>;
    tapping-term-ms = <175>;
    flavor = "tap-preferred";
    quick-tap-ms = <150>;
)
ZMK_BEHAVIOR(kp_msc, hold_tap,
    bindings = <&msc>, <&kp>;
    tapping-term-ms = <175>;
    flavor = "balanced";
    quick-tap-ms = <150>;
    hold-trigger-key-positions = <21 22 23 24 45>;
    require-prior-idle-ms = <150>;
)
ZMK_BEHAVIOR(tap_repeat_mouse_word, hold_tap,
    bindings = <&mouse_word>, <&key_repeat>;
    tapping-term-ms = <175>;
    quick-tap-ms = <150>;
    require-prior-idle-ms = <150>;
    flavor = "tap-preferred";
)
/* ZMK_BEHAVIOR(smart_sk_lt, hold_tap, */
/*     bindings = <&lt>, <&tap_sk_shift_dot_caps_word_lt>; */
/*     tapping-term-ms = <500>; */
/*     quick-tap-ms = <450>; */
/*     flavor = "balanced"; */
/*     hold-trigger-key-positions = <0 1 2 3 4 5 7 8 9 10 11 12 13 14 15 16 17 18 19 20 21 22 23 24 25 26 27 28 29 30 31 32 33 34 35 36 37 38 39 40 41 42 43 44 45 46 47 6>; */
/* ) */
