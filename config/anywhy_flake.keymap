#define CONFIG_WIRELESS
#define ZMK_BASE_LAYER(name, LT, RT, LM, RM, LB, RB, LH, RH)                   \
    ZMK_LAYER(                                                                 \
        name,                                                                  \
                 LT RT                                                         \
                 LM RM                                                         \
                 LB RB                                                         \
        &kp LGUI LH RH &smart_mouse                                            \
    )

#include "zmk-helpers/helper.h"

#include "base.keymap"

/{ chosen { zmk,physical-layout = &medium_layout; }; };
