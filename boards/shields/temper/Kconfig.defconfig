## boards/shields/temper/Kconfig.defconfig
```kconfig
if SHIELD_TEMPER_LEFT

config ZMK_KEYBOARD_NAME
    default "temper"

config ZMK_SPLIT_ROLE_CENTRAL
    default y

endif

if SHIELD_TEMPER_LEFT || SHIELD_TEMPER_RIGHT

config ZMK_SPLIT
    default y

endif
```

## boards/shields/temper/Kconfig.shield
```kconfig
# Copyright (c) 2020 Pete Johanson
# SPDX-License-Identifier: MIT

config SHIELD_TEMPER_LEFT
    def_bool $(shields_list_contains,temper_left)

config SHIELD_TEMPER_RIGHT
    def_bool $(shields_list_contains,temper_right)
```

## config/boards/arm/eyelash_sofle/Kconfig.board
```kconfig
#
# Copyright (c) 2024 The ZMK Contributors
# SPDX-License-Identifier: MIT
#

config BOARD_EYELASH_SOFLE_LEFT
    bool "eyelash_sofle left"
    depends on SOC_NRF52840_QIAA

config BOARD_EYELASH_SOFLE_RIGHT
    bool "eyelash_sofle right"
    depends on SOC_NRF52840_QIAA
```

## config/boards/arm/eyelash_sofle/Kconfig.defconfig
```kconfig
#
# Copyright (c) 2024 The ZMK Contributors
# SPDX-License-Identifier: MIT
#

if BOARD_EYELASH_SOFLE_LEFT

config ZMK_KEYBOARD_NAME
    default "Eyelash Sofle"

config ZMK_SPLIT_ROLE_CENTRAL
    default y

endif # BOARD_EYELASH_SOFLE_LEFT


if BOARD_EYELASH_SOFLE_LEFT || BOARD_EYELASH_SOFLE_RIGHT

config BOARD
    default "eyelash_sofle"

config BOARD_ENABLE_DCDC
    bool "Enable DCDC mode"
    select SOC_DCDC_NRF52X
    default y
    depends on (BOARD_EYELASH_SOFLE_LEFT || BOARD_EYELASH_SOFLE_RIGHT)

config BOARD_ENABLE_DCDC_HV
    bool "Enable High Voltage DCDC converter"
    default y
    select SOC_DCDC_NRF52X_HV
    depends on (BOARD_EYELASH_SOFLE_LEFT || BOARD_EYELASH_SOFLE_RIGHT)

config ZMK_SPLIT
    default y

config BT_CTLR
    default BT

if USB

config USB_NRFX
    default y

config USB_DEVICE_STACK
    default y

endif # USB

if ZMK_DISPLAY

config I2C
   default y

config SSD1306
    default y

choice ZMK_DISPLAY_WORK_QUEUE
    default ZMK_DISPLAY_WORK_QUEUE_DEDICATED
endchoice

endif

if SSD1306

config LV_Z_VDB_SIZE
   default 64

config LV_DPI_DEF
    default 148

config LV_Z_BITS_PER_PIXEL
    default 1

choice LV_COLOR_DEPTH
    default LV_COLOR_DEPTH_1
endchoice

endif

if ZMK_BACKLIGHT

config PWM
    default y

config LED_PWM
    default y

endif # ZMK_BACKLIGHT

endif # BOARD_EYELASH_SOFLE_LEFT || BOARD_EYELASH_SOFLE_RIGHT
```

## config/boards/arm/eyelash_sofle/eyelash_sofle_left_defconfig
```kconfig
#
# Copyright (c) 2022 Darryl deHaan
# SPDX-License-Identifier: MIT
#

CONFIG_SOC_SERIES_NRF52X=y
CONFIG_SOC_NRF52840_QIAA=y
CONFIG_BOARD_EYELASH_SOFLE_LEFT=y
CONFIG_ZMK_SLEEP=y




# Enable MPU
CONFIG_ARM_MPU=y

# enable pinctrl
CONFIG_PINCTRL=y

# enable GPIO
CONFIG_GPIO=y

# Enable SPI
CONFIG_SPI=y

# Enable writing to flash
CONFIG_USE_DT_CODE_PARTITION=y
CONFIG_BUILD_OUTPUT_UF2=y
CONFIG_MPU_ALLOW_FLASH_WRITE=y
CONFIG_NVS=y
CONFIG_SETTINGS_NVS=y
CONFIG_FLASH=y
CONFIG_FLASH_PAGE_LAYOUT=y
CONFIG_FLASH_MAP=y

# Enable 32kHz crystal
CONFIG_CLOCK_CONTROL_NRF_K32SRC_XTAL=y
CONFIG_CLOCK_CONTROL_NRF_K32SRC_30PPM=y

CONFIG_ZMK_USB=y
CONFIG_ZMK_BLE=y

# enable display drivers
CONFIG_ZMK_DISPLAY=y



#CONFIG_ZMK_DISPLAY_WORK_QUEUE_DEDICATED=y
#CONFIG_ZMK_DISPLAY_DEDICATED_THREAD_STACK_SIZE=2048
#CONFIG_LV_Z_BITS_PER_PIXEL=1
#CONFIG_LV_COLOR_DEPTH_1=y
#CONFIG_LV_DPI_DEF=145
#CONFIG_LV_Z_VDB_SIZE=100
#CONFIG_LV_USE_THEME_MONO=y
#CONFIG_LV_COLOR_CHROMA_KEY_HEX=0x00FF00
#CONFIG_ZMK_LV_FONT_DEFAULT_SMALL_MONTSERRAT_16=y
#CONFIG_LV_FONT_MONTSERRAT_26=y
#CONFIG_LV_FONT_DEFAULT_MONTSERRAT_26=y


#EXT POWER
CONFIG_ZMK_EXT_POWER=y

#BLE-passkey
CONFIG_ZMK_BLE_PASSKEY_ENTRY=n

#BLE-clean
CONFIG_ZMK_BLE_CLEAR_BONDS_ON_START=n

#usb-name
CONFIG_USB_DEVICE_MANUFACTURER="sofle"

CONFIG_BT_CTLR_TX_PWR_PLUS_8=y

CONFIG_ZMK_HID_REPORT_TYPE_NKRO=n
#CONFIG_ZMK_HID_CONSUMER_REPORT_USAGES_BASIC=y

#EC11 enable
CONFIG_EC11=y
CONFIG_EC11_TRIGGER_GLOBAL_THREAD=y
CONFIG_ZMK_POINTING=y
```

## config/boards/arm/eyelash_sofle/eyelash_sofle_right_defconfig
```kconfig
#
# Copyright (c) 2024 The ZMK Contributors
# SPDX-License-Identifier: MIT
#

CONFIG_SOC_SERIES_NRF52X=y
CONFIG_SOC_NRF52840_QIAA=y
CONFIG_BOARD_EYELASH_SOFLE_RIGHT=y

# Enable 32kHz crystal
CONFIG_CLOCK_CONTROL_NRF_K32SRC_XTAL=y
CONFIG_CLOCK_CONTROL_NRF_K32SRC_30PPM=y

# Enable MPU
CONFIG_ARM_MPU=y

# enable pinctrl
CONFIG_PINCTRL=y

# enable GPIO
CONFIG_GPIO=y

# Enable SPI
CONFIG_SPI=y

# Enable writing to flash
CONFIG_USE_DT_CODE_PARTITION=y
CONFIG_BUILD_OUTPUT_UF2=y
CONFIG_MPU_ALLOW_FLASH_WRITE=y
CONFIG_NVS=y
CONFIG_SETTINGS_NVS=y
CONFIG_FLASH=y
CONFIG_FLASH_PAGE_LAYOUT=y
CONFIG_FLASH_MAP=y

CONFIG_ZMK_USB=n
CONFIG_ZMK_BLE=y

#EXT POWER
CONFIG_ZMK_EXT_POWER=y
```

## config/boards/shields/chipper/Kconfig.defconfig
```kconfig
if SHIELD_CHIPPER_LEFT

config ZMK_KEYBOARD_NAME
	default "Chipper"

config ZMK_SPLIT_BLE_ROLE_CENTRAL
	default y

endif

if SHIELD_CHIPPER_RIGHT

config ZMK_KEYBOARD_NAME
	default "Chipper Right"
	
endif

if SHIELD_CHIPPER_LEFT || SHIELD_CHIPPER_RIGHT

config ZMK_SPLIT
	default y
 

config ZMK_DISPLAY
	select LVGL_USE_CONT
	select LVGL_FONT_MONTSERRAT_26

#choice ZMK_DISPLAY_STATUS_SCREEN
#	default ZMK_DISPLAY_STATUS_SCREEN_CUSTOM

#endchoice

if ZMK_DISPLAY

choice LVGL_THEME_DEFAULT_FONT_NORMAL
    default LVGL_THEME_DEFAULT_FONT_NORMAL_MONTSERRAT_26

endchoice

choice LVGL_THEME_DEFAULT_FONT_SMALL
    default LVGL_THEME_DEFAULT_FONT_SMALL_MONTSERRAT_16

endchoice

config LVGL_HOR_RES_MAX
	default 160

config LVGL_VER_RES_MAX
	default 68

config SPI
	default y

config LS0XX
	default y

config LVGL_BITS_PER_PIXEL
	default 1

choice LVGL_COLOR_DEPTH
	default LVGL_COLOR_DEPTH_1

endchoice

config LVGL_DPI
	default 30

config LVGL_VDB_SIZE
	default 16

endif # ZMK_DISPLAY

endif
```

## config/boards/shields/chipper/Kconfig.shield
```kconfig
config SHIELD_CHIPPER_LEFT
	def_bool $(shields_list_contains,chipper_left)

config SHIELD_CHIPPER_RIGHT
	def_bool $(shields_list_contains,chipper_right) 
```

## config/boards/shields/chipper36/Kconfig.defconfig
```kconfig
if SHIELD_CHIPPER36_LEFT

config ZMK_KEYBOARD_NAME
	default "Chipper36"

config ZMK_SPLIT_BLE_ROLE_CENTRAL
	default y

endif

if SHIELD_CHIPPER36_RIGHT

config ZMK_KEYBOARD_NAME
	default "Chipper36 Right"
	
endif

if SHIELD_CHIPPER36_LEFT || SHIELD_CHIPPER36_RIGHT

config ZMK_SPLIT
	default y

endif
```

## config/boards/shields/chipper36/Kconfig.shield
```kconfig
config SHIELD_CHIPPER36_LEFT
	def_bool $(shields_list_contains,chipper36_left)

config SHIELD_CHIPPER36_RIGHT
	def_bool $(shields_list_contains,chipper36_right) 
```

## config/boards/shields/chipper42/Kconfig.defconfig
```kconfig
if SHIELD_CHIPPER42_LEFT

config ZMK_KEYBOARD_NAME
	default "Chipper42"

config ZMK_SPLIT_BLE_ROLE_CENTRAL
	default y

endif

if SHIELD_CHIPPER42_RIGHT

config ZMK_KEYBOARD_NAME
	default "Chipper42 Right"
	
endif

if SHIELD_CHIPPER42_LEFT || SHIELD_CHIPPER42_RIGHT

config ZMK_SPLIT
	default y

if ZMK_DISPLAY

config I2C
	default y

config SSD1306
	default y

config SSD1306_REVERSE_MODE
	default y

endif # ZMK_DISPLAY

if LVGL

config LV_Z_VDB_SIZE
	default 64

config LV_DPI_DEF
	default 148

config LV_Z_BITS_PER_PIXEL
	default 1

choice LV_COLOR_DEPTH
	default LV_COLOR_DEPTH_1
endchoice

endif # LVGL

endif
```

## config/boards/shields/chipper42/Kconfig.shield
```kconfig
config SHIELD_CHIPPER42_LEFT
	def_bool $(shields_list_contains,chipper42_left)

config SHIELD_CHIPPER42_RIGHT
	def_bool $(shields_list_contains,chipper42_right) 
```

## config/boards/shields/eyelash_sofle/Kconfig.shield
```kconfig
# Copyright (c) 2020 The ZMK Contributors
# SPDX-License-Identifier: MIT

config SHIELD_EYELASH_SOFLE_LEFT
    def_bool $(shields_list_contains,eyelash_sofle_left)

config SHIELD_EYELASH_SOFLE_RIGHT
    def_bool $(shields_list_contains,eyelash_sofle_right)
```

## config/boards/shields/nice_view_gem/Kconfig.defconfig
```kconfig
if SHIELD_NICE_VIEW_GEM

config LV_Z_VDB_SIZE
    default 100

config LV_DPI_DEF
    default 161

config LV_Z_BITS_PER_PIXEL
    default 1

choice LV_COLOR_DEPTH
    default LV_COLOR_DEPTH_1
endchoice

choice ZMK_DISPLAY_WORK_QUEUE
    default ZMK_DISPLAY_WORK_QUEUE_DEDICATED
endchoice

choice ZMK_DISPLAY_STATUS_SCREEN
    default ZMK_DISPLAY_STATUS_SCREEN_CUSTOM
endchoice

config LV_Z_MEM_POOL_SIZE
    default 4096 if ZMK_DISPLAY_STATUS_SCREEN_CUSTOM

config ZMK_DISPLAY_STATUS_SCREEN_CUSTOM
    imply NICE_VIEW_WIDGET_STATUS

config NICE_VIEW_GEM_WPM_FIXED_RANGE
    bool "Enable fixed range for WPM gauge/chart"
    default y

config NICE_VIEW_GEM_WPM_FIXED_RANGE_MAX
    int "Fixed range maximum for WPM gauge/chart"
    default 100

config NICE_VIEW_GEM_ANIMATION
    bool "Enable animation on peripheral"
    default y

config NICE_VIEW_GEM_ANIMATION_MS
    int "Animation length in milliseconds"
    default 960

config NICE_VIEW_WIDGET_STATUS
    select LV_USE_LABEL
    select LV_USE_IMG
    select LV_USE_CANVAS
    select LV_USE_ANIMIMG
    select LV_USE_ANIMATION

config NICE_VIEW_WIDGET_INVERTED
    bool "Invert display colors"

if !ZMK_SPLIT || ZMK_SPLIT_ROLE_CENTRAL

config NICE_VIEW_WIDGET_STATUS
    select ZMK_WPM

endif # !ZMK_SPLIT || ZMK_SPLIT_ROLE_CENTRAL

endif # SHIELD_NICE_VIEW_GEM
```

## config/boards/shields/totem/Kconfig.defconfig
```kconfig
if SHIELD_TOTEM_LEFT

config ZMK_KEYBOARD_NAME
    default "TOTEM"
    
config ZMK_SPLIT_ROLE_CENTRAL
    default y

endif

if SHIELD_TOTEM_LEFT || SHIELD_TOTEM_RIGHT

config ZMK_SPLIT
    default y

endif
```

## config/boards/shields/totem/Kconfig.shield
```kconfig
config SHIELD_TOTEM_LEFT
    def_bool $(shields_list_contains,totem_left)

config SHIELD_TOTEM_RIGHT
    def_bool $(shields_list_contains,totem_right)
```
